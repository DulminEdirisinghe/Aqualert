//########################################################
#include "HX711.h" //Scale

// HX711 circuit wiring
const int LOADCELL_DOUT_PIN = 2;
const int LOADCELL_SCK_PIN = 13;
HX711 scale;
//########################################################

#include <EEPROM.h>
#define HIGH 0x1
#define LOW 0x0

//########################################################
#include <Wire.h>         //Screen
#include <Adafruit_SSD1306.h>
#include <Adafruit_GFX.h>
#define OLED_WIDTH 128
#define OLED_HEIGHT 32
#define OLED_ADDR   0x3C
Adafruit_SSD1306 display(OLED_WIDTH, OLED_HEIGHT);
//########################################################

int flag = 1; // flag to check whether user have pressed blink off

unsigned long  time; 

//float totalIntake = 0; // total water
float totalIntake; // start as hydrated

float peakOld;
float peakNow; //to differentiate between user scenarios
float Current_weight; //stores the current weight of the scale

//LED or lamp(the pin to the transistor)
const int LED = 9;


//Light Switch in the back
const int LightPin =A3; //J3 header 3 and 4
boolean Light=digitalRead(LightPin);
  
// Front panel
const int blinkOffPin = A0;  //J3 header 1 and 2
const int avgUpPin = A1; //J4 header 3 and 4
const int avgDownPin = A2; //J3 header 1 and 2


boolean blinkOff=digitalRead(blinkOffPin);
boolean avgUp=digitalRead(avgUpPin);
boolean avgDown=digitalRead(avgDownPin);

float maxW =3000;
float minW =700; // water level limits to set avg level in ml per hour
float defaultW =700; // to compensate when the bottle is not on the device

const unsigned char waterDrop [] PROGMEM = {
	0x00, 0x00, 0x00, 0x00, 0x00, 0x00, 0x00, 0x00, 0x00, 0x00, 0x00, 0x00, 0x00, 0x00, 0x00, 0x00, 
	0x00, 0x00, 0x00, 0x00, 0x00, 0x00, 0x00, 0x00, 0x00, 0x00, 0x00, 0x00, 0x00, 0x00, 0x00, 0x00, 
	0x00, 0x00, 0x00, 0x00, 0x00, 0x00, 0x00, 0x01, 0x00, 0x00, 0x00, 0x00, 0x00, 0x00, 0x00, 0x00, 
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	0x00, 0x00, 0x00, 0x00, 0x00, 0x00, 0x00, 0x00, 0x00, 0x00, 0x00, 0x00, 0x00, 0x00, 0x00, 0x00
};

const unsigned char face [] PROGMEM = {
	0x00, 0x00, 0x00, 0x00, 0x00, 0x00, 0x00, 0x00, 0x00, 0x00, 0x00, 0x00, 0x00, 0x00, 0x00, 0x00, 
	0x00, 0x00, 0x00, 0x00, 0x00, 0x00, 0x00, 0x00, 0x00, 0x00, 0x00, 0x00, 0x00, 0x00, 0x00, 0x00, 
	0x00, 0x00, 0x00, 0x00, 0x00, 0x00, 0x00, 0x00, 0x00, 0x00, 0x00, 0x00, 0x00, 0x00, 0x00, 0x00, 
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	0x00, 0x00, 0x00, 0x00, 0x00, 0x00, 0x00, 0x00, 0x00, 0x00, 0x00, 0x00, 0x00, 0x00, 0x00, 0x00
};

//################################################################

// Returns the time in minutes from the beginning. This function is called once a thirty minutes.

unsigned long minutes() {

  time=((millis()) / 60000UL) +59;
    return time;    
  }
//################################################################

//To calculate the average water intake of the user per hour

float avg  ; // stores the average water that user consumed

float average(float totalIntake){
  
    return(totalIntake*60/(minutes()));
  }

//####################################################

// Gives a warning to the user by blinking the lamp or leds

void blink(float Current_weight){

  while (Current_weight-50 < scale.get_units() and digitalRead(blinkOffPin) == HIGH and flag == 1){   // we reduce 50 so that user should at least drink 20000 worth of water to off the alarm.Or else user can press the push button and gnd the pin

      digitalWrite(LED,1);
      Screen("Drink"); 
      digitalWrite(LED,0);   
      Screen("WATER");
                  //led warning off with light off
      
  }
  if(digitalRead(blinkOffPin) == LOW){
        flag =0; // user press and hold blink off button, prevent restarting blink
        delay(500);
      }


}

void setup() {
  Serial.begin(9600);
  scale.begin(LOADCELL_DOUT_PIN, LOADCELL_SCK_PIN);
  pinMode(LED,OUTPUT);      // transistor input
  pinMode(LightPin,INPUT);  // light switch in back io
  pinMode(blinkOffPin, INPUT); //blink on switch in front
  pinMode(avgUpPin, INPUT); // avg up switch front
  pinMode(avgDownPin, INPUT);// avg dwn switch front

  display.begin(SSD1306_SWITCHCAPVCC, OLED_ADDR);
  display.clearDisplay(); 
  display.begin(SSD1306_SWITCHCAPVCC, OLED_ADDR);
  display.clearDisplay();
  display.setTextSize(2);
  display.setTextColor(WHITE);
  display.setCursor(0, 0);

  display.display(); 

  display.clearDisplay();
  display.setCursor(0, 0);
  display.println("Wait");  // wait for tare
  display.display();
  delay(2000);
  scale.set_offset(152213);  scale.set_scale(554.444); 
  scale.tare(10);
  delay(500);
  display.clearDisplay();
  
  display.clearDisplay();
  display.setCursor(0, 0);
  display.println("Ready");  // wait for tare
  display.display();
  delay(5000);
  display.clearDisplay();
  
  avg=EEPROM.read(0);
  
  if(avg>minW and avg<maxW){
    
   avg=EEPROM.read(0); //  get set lvl or default lvl from memory##########################
      
  }
  
  else{
    avg =defaultW;
    EEPROM.write(0,defaultW);
  }

  totalIntake = avg; //hydrated at start

  if (digitalRead(LightPin) ==LOW){  
     
    //Turn on the LED at beginning depend on users preference
    digitalWrite(LED,1);
    
  }

  else{

    digitalWrite(LED,0);
    
  }
  
Current_weight = scale.get_units(10);
peakOld =Current_weight;
peakNow =Current_weight;
}


void Screen(String str ){
  
  display.clearDisplay();
  display.setCursor(0, 0);
  display.println(str);
  display.display();
  delay(500);
  display.clearDisplay();


}



void loop() {
  
    if(digitalRead(avgUpPin) == LOW){
      if (avg < maxW){
        avg+=200; // increase avg water by 10;
        Screen(String(avg)+"ml");
        EEPROM.write(0, avg); // update avg in memory -- may cause eeprom degrade   maybe send the code to setup 
        delay(1000);
        }
      else{
        Screen("Max");
        delay(1000);
        }
      return;
    }
    if(digitalRead(avgDownPin) == LOW){
      if (avg > minW){
        avg-=200; // increase avg water by 10;
        EEPROM.write(0, avg); // update avg in memory -- may cause eeprom degrade
        Screen(String(avg)+"ml");
        delay(1000);
        }
      else{
        Screen("Min");
        delay(1000);
        }
      return; // go to beginning void loop
    }

    Current_weight = scale.get_units(10);
    
    
    // checking every  between 29and 31 mins
    //Serial.println(minutes()%1);
    if (minutes()%30 ==0 and average(totalIntake)<=avg){    
      blink(Current_weight);
    }
    if (minutes()% 37==0 and average(totalIntake)<=avg){    
      flag = 1; //reset blink flag for next cycle
    }
    if (digitalRead(LightPin) == LOW){             //turn on the light back on only if lamp button on
          digitalWrite(LED,1);
    }
    else{
      digitalWrite(LED,0);
    }
    if (Current_weight < peakNow and abs(Current_weight - peakNow)>50){
      peakOld=peakNow;
      peakNow=Current_weight;
      totalIntake += (peakOld - peakNow);
      }
    if (Current_weight > peakNow and abs(Current_weight - peakNow)>50){
        totalIntake = avg*minutes();
        peakNow=Current_weight;
        peakOld=Current_weight;
        
      }
    //Screen(String(average(totalIntake)));

    if (average(totalIntake)<avg)
    {
        
        Screen("Drink");
        display.clearDisplay();
        display.drawBitmap(0, 0,  waterDrop, 128, 32, 1);
        display.display();
        display.clearDisplay();
  
      }
    else{
        
        display.drawBitmap(0, 0,  face, 128, 32, 1);
        display.display();
        display.clearDisplay();
        }
      
//Screen(String(Current_weight));
}